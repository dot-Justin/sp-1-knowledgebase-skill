## assets/sp1-midi-2026-05-13/Kconfig
```kconfig
mainmenu "Stem Player"

source "Kconfig.zephyr"

rsource "drivers/audio/Kconfig"
rsource "drivers/charger/Kconfig"
```

## assets/sp1-midi-2026-05-13/boards/teenageengineering/stem_player/Kconfig.defconfig
```kconfig
# SPDX-License-Identifier: Apache-2.0

if BOARD_STEM_PLAYER

source "boards/common/usb/Kconfig.cdc_acm_serial.defconfig"

endif # BOARD_STEM_PLAYER
```

## assets/sp1-midi-2026-05-13/boards/teenageengineering/stem_player/Kconfig.stem_player
```kconfig
# SPDX-License-Identifier: Apache-2.0

config BOARD_STEM_PLAYER
    select SOC_NRF52840_QIAA
```

## assets/sp1-midi-2026-05-13/boards/teenageengineering/stem_player/stem_player_defconfig
```kconfig
# SPDX-License-Identifier: Apache-2.0

CONFIG_GPIO=y
CONFIG_SERIAL=y
CONFIG_UART_NRFX=y
CONFIG_I2C=y
CONFIG_I2S=y
CONFIG_PWM=y
CONFIG_ADC=y
CONFIG_PINCTRL=y
CONFIG_CLOCK_CONTROL_NRF_K32SRC_SYNTH=y
CONFIG_USE_DT_CODE_PARTITION=y
```

## assets/sp1-midi-2026-05-13/drivers/audio/Kconfig
```kconfig
menu "Stem Player Audio Drivers"

config STEM_PLAYER_AUDIO_CODEC_CS42L42
	bool "CS42L42 codec driver"
	default y
	depends on AUDIO_CODEC

config STEM_PLAYER_AUDIO_CODEC_TAS2505
	bool "TAS2505 codec driver"
	default y
	depends on AUDIO_CODEC

endmenu
```

## assets/sp1-midi-2026-05-13/drivers/charger/Kconfig
```kconfig
menu "Stem Player Charger Drivers"

config STEM_PLAYER_CHARGER_BQ24232
	bool "BQ24232 charger driver"
	default y
	depends on CHARGER

endmenu
```

## assets/sp1-midi-2026-05-13/dts/bindings/audio/cirrus,cs42l42.yaml
```yaml
# SPDX-License-Identifier: Apache-2.0

description: Cirrus Logic CS42L42 audio codec

include: [i2c-device.yaml]

compatible: "cirrus,cs42l42"

properties:
  reset-gpios:
    type: phandle-array
    required: true
    description: Active-low reset pin for the codec.
```

## assets/sp1-midi-2026-05-13/dts/bindings/audio/ti,tas2505.yaml
```yaml
# SPDX-License-Identifier: Apache-2.0

description: Texas Instruments TAS2505 audio amplifier / codec

include: [i2c-device.yaml]

compatible: "ti,tas2505"

properties:
  reset-gpios:
    type: phandle-array
    required: true
    description: Active-low reset pin for the amplifier / codec.
```

## assets/sp1-midi-2026-05-13/dts/bindings/charger/ti,bq24232.yaml
```yaml
# SPDX-License-Identifier: Apache-2.0

description: Texas Instruments BQ24232 standalone charger with GPIO control/status pins

compatible: "ti,bq24232"

include: base.yaml

properties:
  pgood-gpios:
    type: phandle-array
    required: true
    description: Active-state power-good indication for valid external input power.

  chg-gpios:
    type: phandle-array
    required: true
    description: Active-state charge-status indication while a charge cycle is in progress.

  ce-gpios:
    type: phandle-array
    required: true
    description: Charge enable control. The active state enables charging.

  iset-override-gpios:
    type: phandle-array
    required: true
    description: |
      Charge-current override control. The active state enables the alternate
      ISET path used by the board to reduce charge current.
```

## assets/sp1-midi-2026-05-13/dts/bindings/storage/teenageengineering,stem-emmc.yaml
```yaml
# SPDX-License-Identifier: Apache-2.0

description: Teenage Engineering Stem Player eMMC device wrapper

compatible: "teenageengineering,stem-emmc"

include:
  - name: base.yaml
  - name: power.yaml
    property-allowlist:
      - supply-gpios
      - vin-supply

properties:
  reset-gpios:
    type: phandle-array
    required: true
    description: Active-low reset pin for the eMMC device.
```
